## conf/machine/ebaz4205-zynq7.conf
```bitbake
#@TYPE: Machine
#@NAME: ebaz4205-zynq7
#@DESCRIPTION: Machine support for the EBAZ4205 Zynq-7010 board.

require conf/machine/zynq-generic.conf

# Hardware specs
STAGING_KERNEL_DIR ?= "${TMPDIR}/work-shared/${MACHINE}/kernel-source"

# U-Boot Configurations
UBOOT_MACHINE = "xilinx_zynq_virt_defconfig"
UBOOT_EXTRA_ENV = "board=ebaz4205"

# Device Tree
KERNEL_DEVICETREE = "ebaz4205.dtb"

# 1. Disable all Xilinx bootbin recipe hooks that require the multiconfig FSBL
do_image[mcdepends] = ""
FSBL_MCDEPENDS = ""
FSBL_DEPENDS = ""

# 2. Tell the system we are using U-Boot SPL instead of FSBL
SPL_BINARY = "spl/u-boot-spl.bin"

# 3. Adjust bootbin generation variables to package SPL instead of fsbl-firmware
BIF_PARTITION_IMAGE[fsbl] = "${DEPLOY_DIR_IMAGE}/u-boot-spl.bin"

# 4. Completely decouple bitstream variables from the BIF attributes
BIF_PARTITION_ATTR = "fsbl u-boot"

# 5. Force Bitbake to ignore the virtual/bitstream dependency
# This overrides the dynamic replacement code in xilinx-bootbin.bb
DEPENDS:pn-xilinx-bootbin:remove = "virtual/bitstream"

# 6. Explicitly tell the bitstream recipe provider that we are empty-handed
# This keeps the bitstream recipe from throwing skip errors during parsing
BITSTREAM_PATH = ""
```

## meta-ebaz4205/conf/machine/ebaz4205-zynq7.conf
```bitbake
#@TYPE: Machine
#@NAME: ebaz4205-zynq7
#@DESCRIPTION: Machine support for the EBAZ4205 Zynq-7000 Board.

require conf/machine/zynq-generic.conf

SERIAL_CONSOLES = "115200;ttyPS0"

# 1. U-Boot & SPL Settings
PREFERRED_PROVIDER_virtual/bootloader = "u-boot-xlnx"
PREFERRED_PROVIDER_u-boot = "u-boot-xlnx"
UBOOT_MACHINE = "xilinx_zynq_virt_defconfig"

# Enable U-Boot SPL generation and tell Yocto to produce BOOT.bin
SPL_BINARY = "spl/boot.bin"
UBOOT_BINARY = "u-boot.img"
UBOOT_IMAGE = "u-boot-${MACHINE}-${PV}-${PR}.img"
UBOOT_SYMLINK = "u-boot.img"

# Generate BOOT.bin from SPL
UBOOT_SIGN_ENABLE = "0"
IMAGE_CLASSES += "uboot-sign"

# 2. Kernel Settings
KERNEL_IMAGETYPE = "uImage"
KERNEL_EXTRA_ARGS += "LOADADDR=0x8000"

# 3. Clean up FSBL dependencies
PREFERRED_PROVIDER_virtual/fsbl = ""
EXTRA_IMAGEDEPENDS:remove = "virtual/fsbl"
EXTRA_IMAGEDEPENDS:remove = "fsbl"

# 4. Boot Artifacts Deployment
IMAGE_BOOT_FILES = "BOOT.bin uImage devicetree.dtb"
```
